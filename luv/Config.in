## luv/Config.in
```kconfig
config LUV_USE_LUAJIT_ENGINE
	bool "Use luajit engine"
	depends on PACKAGE_luv
	select PACKAGE_luajit
	help
		If selected, luv will be compiled against luajit. If not selected, luv will use Lua as engine.
	default y
```
